## pith-recovery/sdkconfig.defaults
```kconfig
# --- pith-recovery defaults (ESP32-S3) ---
# Minimal vs the main firmware: no USB composite, no LED strip — just the panels,
# touch, NVS and OTA slot control needed to show the countdown + recovery menu and
# chain-load the main firmware.

# Console on the built-in USB-Serial-JTAG (the 303a:1001 port) so logs + the boot
# chain are readable over USB without a UART adapter. Recovery doesn't use the
# native USB-OTG, so there's no conflict.
CONFIG_ESP_CONSOLE_USB_SERIAL_JTAG=y

CONFIG_ESP_MAIN_TASK_STACK_SIZE=12288

# 8 MB Octal PSRAM — holds the 480x320x2 (~300 KB) framebuffer.
CONFIG_SPIRAM=y
CONFIG_SPIRAM_MODE_OCT=y
CONFIG_SPIRAM_SPEED_80M=y
CONFIG_SPIRAM_USE_MALLOC=y
CONFIG_SPIRAM_MALLOC_ALWAYSINTERNAL=4096
CONFIG_ESP_DEFAULT_CPU_FREQ_MHZ_240=y
CONFIG_FREERTOS_HZ=1000

# 8 MB flash with the SHARED custom partition table (factory recovery + dual-OTA
# main). Both images build the same table so a full flash of either is consistent.
CONFIG_ESPTOOLPY_FLASHSIZE_8MB=y
CONFIG_ESPTOOLPY_FLASHSIZE="8MB"
CONFIG_PARTITION_TABLE_CUSTOM=y
CONFIG_PARTITION_TABLE_CUSTOM_FILENAME="partitions.csv"
```
